## srtp2-project/drivers/input/nunchukng/Kconfig
```kconfig
config INPUT_NUNCHUKNG
	bool "Nintendo Nunchuk joystick next gen driver with acceleration data"
	default y
	depends on DT_HAS_NINTENDO_NUNCHUKNG_ENABLED
	select I2C
	help
	  This option enable the next gen driver for the Nintendo Nunchuk joystick.
```

## srtp2-project/lib/srtp2/Kconfig
```kconfig
config SRTP2
	bool "Support for SRTP2 protocol"
	help
	  This option enables the 'SRTP2' (Simple real-time Protocol v2 library
```
